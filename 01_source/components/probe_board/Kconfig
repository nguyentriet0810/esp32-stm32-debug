## 01_source/components/probe_board/Kconfig
```kconfig
# @file Kconfig
# @brief PCB hardware profile, optional peripherals and bounded configuration choices.
#
# GPIO defaults follow schematic revision C. The board validator checks enabled assignments again
# at runtime.

# GPIO defaults follow 03_pcb/layout_manual/schematic.kicad_sch (revision C).
menu "STM32 probe hardware"
comment "PCB revision C (REV 1.0): fixed GPIO pin map"
config PROBE_BOARD_PCB_REV_C
    bool
    default y
    help
        Fixed wiring shared by layout_manual and AI_layout (PCB REV 1.0).
        Saved pin assignments are replaced during reconfigure.
        SWDIO/SWCLK/SWO/nRST: 4/5/6/7; OLED SDA/SCL: 8/9;
        encoder A/B/SW: 15/16/17. microSD CS/MOSI/SCK/MISO/CD: 38/39/40/41/42.
config PROBE_SWDIO_GPIO
    int
    range 0 31
    default 4
config PROBE_SWCLK_GPIO
    int
    range 0 31
    default 5
config PROBE_NRST_GPIO
    int
    range 0 31
    default 7
config PROBE_SWO_GPIO
    int
    range 0 48
    default 6
config PROBE_SWD_DEFAULT_HZ
    int "Initial SWD frequency (Hz)"
    range 1000 8000000
    default 400000
config PROBE_OLED_ENABLE
    bool "Enable optional SSD1306 OLED"
    default y
config PROBE_OLED_SDA_GPIO
    int
    range 0 48
    default 8
config PROBE_OLED_SCL_GPIO
    int
    range 0 48
    default 9
config PROBE_ENCODER_ENABLE
    bool "Enable optional encoder input"
    default y
config PROBE_ENCODER_A_GPIO
    int
    range 0 48
    default 15
config PROBE_ENCODER_B_GPIO
    int
    range 0 48
    default 16
config PROBE_ENCODER_SW_GPIO
    int
    range 0 48
    default 17
config PROBE_SD_ENABLE
    bool "Enable optional microSD (SPI/FAT)"
    default y
    help
        Mount an inserted FAT card at /sdcard during startup.
        Missing cards and mount errors do not stop the debug probe.
        No automatic formatting is performed. Use the console sd commands
        to mount after insertion or unmount before removing the card.
config PROBE_SD_CS_GPIO
    int
    range 0 48
    default 38
config PROBE_SD_MOSI_GPIO
    int
    range 0 48
    default 39
config PROBE_SD_SCK_GPIO
    int
    range 0 48
    default 40
config PROBE_SD_MISO_GPIO
    int
    range 0 48
    default 41
config PROBE_SD_DETECT_GPIO
    int
    range 0 48
    default 42
config PROBE_SD_MAX_FREQ_KHZ
    int "Maximum microSD SPI clock (kHz)"
    range 400 20000
    default 4000
config PROBE_GDB_PORT
    int "GDB TCP port"
    range 1024 65535
    default 2022
endmenu
```
